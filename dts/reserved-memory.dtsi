/ {
	reserved-memory {
		#address-cells = <2>;
		#size-cells = <2>;
		ranges;

		mrl-rgn@8d4000000 {
			compatible = "smsi,mrl-region";
			reg = <0x0 0x43000000 0x0 0x1000000>; //16M
			no-map;
		};

		/* global autoconfigured region for contiguous allocations */
		linux,cma {
			compatible = "shared-dma-pool";
			reusable;
			size = <0x00000000 0x04000000>;
			linux,cma-default;
		};

	};
};
