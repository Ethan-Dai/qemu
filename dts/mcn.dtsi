#include "reserved-memory.dtsi"

/ {
	pcu: pcu@43980000 {
		reg = <0x00 0x43980000 0x00 0x1000>;
	};

	mcn@43000000 {
		compatible = "qemu,mcn";
		reg = <0x00 0x43000000 0x00 0x980000>;
		pcu = <&pcu>;

		interrupts = <0x00 215 0x1>,	//PPU
			     <0x00 214 0x1>,	//PMU
			     <0x00 216 0x1>,	//ERRNS
			     <0x00 218 0x1>,	//FAULTNS
			     <0x00 220 0x1>;	//MPAMERRNS
	};
};
